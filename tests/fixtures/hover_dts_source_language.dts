/dts-v1/;

/include/ "included.dtsi"

/memreserve/ 0x10000000 0x4000;

/ {
    source_label: syntax-node {
        expression = <(1 + 2) (4 << 1) (1 && 0) (3 >= 2) (1 ? 2 : 3)>;
        bytes = [00 00 12 34 56 78];
        strings = "first", "second";
        reference = <&source_label>;
        path-reference = <&{/syntax-node}>;
    };

    /delete-node/ obsolete-node;
    /delete-property/ obsolete-property;
};
