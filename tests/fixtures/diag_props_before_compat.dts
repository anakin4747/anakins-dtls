// SPDX-License-Identifier: GPL-2.0
/dts-v1/;

/ {
	#address-cells = <1>;
	#size-cells = <1>;

	clock-16000000 {
		#clock-cells = <0>;
		clock-frequency = <16000000>;
		compatible = "fixed-clock";
	};
};
