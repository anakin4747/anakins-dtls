// Minimal fixture: qcom,sa8255p-geni-uart node with interrupt-names.
// interrupt-names is NOT in standard DT hover docs but IS described in
// Documentation/devicetree/bindings/serial/qcom,sa8255p-geni-uart.yaml
/ {
	serial@990000 {
		compatible = "qcom,sa8255p-geni-uart";
		reg = <0x990000 0x4000>;
		interrupts = <0 531 4>;
		interrupt-names = "uart", "wakeup";
		power-domains = <&scmi0_pd 0>, <&scmi0_dvfs 0>;
		power-domain-names = "power", "perf";
	};
};
