/ {
	#address-cells = <1>;

	memory@a800 {
		reg = <0x0000a800 0x17ff5800>, /* boot ROM to r-bus */
		      <0x18070000 0x00090000>, /* r-bus to NOR flash */
		      <0x19100000 0x26f00000>; /* NOR flash to 1 GiB */
	};
};
